## boards/shields/alitbkmini/Kconfig.defconfig
```kconfig
if SHIELD_ALITBKMINI_LEFT

config ZMK_KEYBOARD_NAME
    default "alitbkmini L"

config ZMK_SPLIT_BLE_ROLE_CENTRAL
    default y

endif

if SHIELD_ALITBKMINI_RIGHT

config ZMK_KEYBOARD_NAME
    default "alitbkmini R"

endif

if SHIELD_ALITBKMINI

config ZMK_SPLIT
    default y

config ZMK_SPLIT_BLE_LOG_LEVEL_DBG
    default y

config BT_LOG_LEVEL_DBG
    default y

config BT_SMP
    default y

endif
```

## boards/shields/alitbkmini/Kconfig.shield
```kconfig
config SHIELD_ALITBKMINI
    bool

config SHIELD_ALITBKMINI_LEFT
    def_bool $(shields_list_contains,alitbkmini_left)
        select SHIELD_ALITBKMINI

config SHIELD_ALITBKMINI_RIGHT
    def_bool $(shields_list_contains,alitbkmini_right)
        select SHIELD_ALITBKMINI
```
