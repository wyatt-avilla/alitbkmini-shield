#include "alitbkmini.dtsi"

&kscan0 {
	col-gpios
		= <&gpio1 6  (GPIO_PULL_DOWN | GPIO_ACTIVE_HIGH)>
		, <&gpio1 4  (GPIO_PULL_DOWN | GPIO_ACTIVE_HIGH)>
		, <&gpio0 11 (GPIO_PULL_DOWN | GPIO_ACTIVE_HIGH)>
		, <&gpio1 0  (GPIO_PULL_DOWN | GPIO_ACTIVE_HIGH)>
		, <&gpio0 24 (GPIO_PULL_DOWN | GPIO_ACTIVE_HIGH)>
		, <&gpio0 22 (GPIO_PULL_DOWN | GPIO_ACTIVE_HIGH)>
		;
};
